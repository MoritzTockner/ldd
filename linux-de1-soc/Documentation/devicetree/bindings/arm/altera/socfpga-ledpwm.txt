## linux-de1-soc/Documentation/devicetree/bindings/arm/altera/socfpga-ledpwm.txt
```
Altera SOCFPGA Ledpwm driver

Required properties:
- compatible : "altr,de1soc-ledpwm"
- reg : Should contain 1 register ranges(address and length)

Example:
	ledpwm0: ledpwm0@ff203080 {
		compatible = "altr,de1soc-ledpwm";
		reg = <0xFF203080 0x4>;
	};
```

## linux-de1-soc/Documentation/devicetree/bindings/misc/pushbutton.txt
```
Pushbutton driver for reading key events on the alter de1soc board.

Required properties:
- compatible :
  - "altr,de1soc-pushbutton"
```
